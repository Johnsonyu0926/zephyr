## prj.conf
```kconfig
# Default base configuration file

# Use a tickless kernel to minimize the number of timer interrupts
CONFIG_TICKLESS_KERNEL=y
CONFIG_SYS_CLOCK_TICKS_PER_SEC=100

# Optimize for speed
CONFIG_SPEED_OPTIMIZATIONS=y

# Disable time slicing
CONFIG_TIMESLICING=n

# Test is only designed for a single CPU
CONFIG_MP_MAX_NUM_CPUS=1

# Disabling hardware stack protection can greatly
# improve system performance.
CONFIG_HW_STACK_PROTECTION=n
```

## src/tm_api.h
```c
/***************************************************************************
 * Copyright (c) 2024 Microsoft Corporation
 *
 * This program and the accompanying materials are made available under the
 * terms of the MIT License which is available at
 * https://opensource.org/licenses/MIT.
 *
 * SPDX-License-Identifier: MIT
 **************************************************************************/

/**************************************************************************/
/**************************************************************************/
/**                                                                       */
/** Thread-Metric Component                                               */
/**                                                                       */
/** Application Interface (API)                                           */
/**                                                                       */
/**************************************************************************/
/**************************************************************************/

/**************************************************************************/
/*                                                                        */
/*  APPLICATION INTERFACE DEFINITION                       RELEASE        */
/*                                                                        */
/*    tm_api.h                                            PORTABLE C      */
/*                                                           6.1.7        */
/*  AUTHOR                                                                */
/*                                                                        */
/*    William E. Lamie, Microsoft Corporation                             */
/*                                                                        */
/*  DESCRIPTION                                                           */
/*                                                                        */
/*    This file defines the basic Application Interface (API)             */
/*    implementation source code for the Thread-Metrics performance       */
/*    test suite. All service prototypes and data structure definitions   */
/*    are defined in this file.                                           */
/*                                                                        */
/*  RELEASE HISTORY                                                       */
/*                                                                        */
/*    DATE              NAME                      DESCRIPTION             */
/*                                                                        */
/*  10-15-2021     William E. Lamie         Initial Version 6.1.7         */
/*                                                                        */
/**************************************************************************/

#ifndef TM_API_H
#define TM_API_H

#include "tm_porting_layer.h"

/*
 * Determine if a C++ compiler is being used.  If so, ensure that standard
 * C is used to process the API information.
 */

#ifdef __cplusplus

/* Yes, C++ compiler is present.  Use standard C.  */
extern "C" {

#endif

/* Define API constants.  */

#define TM_SUCCESS 0
#define TM_ERROR   1

/* Define the time interval in seconds. This can be changed with a -D compiler option.  */

#ifndef TM_TEST_DURATION
#define TM_TEST_DURATION 30
#endif

/*
 * Define RTOS Neutral APIs. RTOS vendors should fill in the guts of the following
 * API. Once this is done the Thread-Metric tests can be successfully run.
 */

void tm_initialize(void (*test_initialization_function)(void));
int tm_thread_create(int thread_id, int priority, void (*entry_function)(void *, void *, void*));
int tm_thread_resume(int thread_id);
int tm_thread_suspend(int thread_id);
void tm_thread_relinquish(void);
void tm_thread_sleep(int seconds);
int tm_queue_create(int queue_id);
int tm_queue_send(int queue_id, unsigned long *message_ptr);
int tm_queue_receive(int queue_id, unsigned long *message_ptr);
int tm_semaphore_create(int semaphore_id);
int tm_semaphore_get(int semaphore_id);
int tm_semaphore_put(int semaphore_id);
int tm_memory_pool_create(int pool_id);
int tm_memory_pool_allocate(int pool_id, unsigned char **memory_ptr);
int tm_memory_pool_deallocate(int pool_id, unsigned char *memory_ptr);

/*
 * Determine if a C++ compiler is being used.  If so, complete the standard
 * C conditional started above.
 */
#ifdef __cplusplus
}
#endif

#endif
```

## src/tm_basic_processing_test.c
```c
/***************************************************************************
 * Copyright (c) 2024 Microsoft Corporation
 *
 * This program and the accompanying materials are made available under the
 * terms of the MIT License which is available at
 * https://opensource.org/licenses/MIT.
 *
 * SPDX-License-Identifier: MIT
 **************************************************************************/

/**************************************************************************/
/**************************************************************************/
/**                                                                       */
/** Thread-Metric Component                                               */
/**                                                                       */
/**   Basic Processing Test                                               */
/**                                                                       */
/**************************************************************************/
/**************************************************************************/

/**************************************************************************/
/*                                                                        */
/*  FUNCTION                                               RELEASE        */
/*                                                                        */
/*    tm_basic_processing_test                            PORTABLE C      */
/*                                                           6.1.7        */
/*  AUTHOR                                                                */
/*                                                                        */
/*    William E. Lamie, Microsoft Corporation                             */
/*                                                                        */
/*  DESCRIPTION                                                           */
/*                                                                        */
/*    This file defines the basic test for determining board processing   */
/*    capabilities                                                        */
/*                                                                        */
/*  RELEASE HISTORY                                                       */
/*                                                                        */
/*    DATE              NAME                      DESCRIPTION             */
/*                                                                        */
/*  10-15-2021     William E. Lamie         Initial Version 6.1.7         */
/*                                                                        */
/**************************************************************************/
#include "tm_api.h"

/* Define the counters used in the demo application...  */

volatile unsigned long tm_basic_processing_counter;

/*
 * Test array.  We will just do a series of calculations on the
 * test array to eat up processing bandwidth. The idea is that
 * all RTOSes should produce the same metric here if everything
 * else is equal, e.g. processor speed, memory speed, etc.
 */

volatile unsigned long tm_basic_processing_array[1024];

/* Define the test thread prototypes.  */

void tm_basic_processing_thread_0_entry(void *p1, void *p2, void *p3);

/* Define the reporting function prototype.  */

void tm_basic_processing_thread_report(void);

/* Define the initialization prototype.  */

void tm_basic_processing_initialize(void);

/* Define main entry point.  */

int main(void)
{
	/* Initialize the test.  */
	tm_initialize(tm_basic_processing_initialize);

	return 0;
}

/* Define the basic processing test initialization.  */

void tm_basic_processing_initialize(void)
{
	/* Create thread 0 at priority 10.  */
	tm_thread_create(0, 10, tm_basic_processing_thread_0_entry);

	/* Resume thread 0.  */
	tm_thread_resume(0);

	tm_basic_processing_thread_report();
}

/* Define the basic processing thread.  */
void tm_basic_processing_thread_0_entry(void *p1, void *p2, void *p3)
{

	int i;

	(void)p1;
	(void)p2;
	(void)p3;

	/* Initialize the test array.   */
	for (i = 0; i < 1024; i++) {

		/* Clear the basic processing array.  */
		tm_basic_processing_array[i] = 0;
	}

	while (1) {

		/*
		 * Loop through the basic processing array, add the previous
		 * contents with the contents of the tm_basic_processing_counter
		 * and xor the result with the previous value...   just to eat
		 * up some time.
		 */

		for (i = 0; i < 1024; i++) {

			/* Update each array entry.  */
			tm_basic_processing_array[i] =
				(tm_basic_processing_array[i] + tm_basic_processing_counter) ^
				tm_basic_processing_array[i];
		}

		/* Increment the basic processing counter.  */
		tm_basic_processing_counter++;
	}
}

/* Define the basic processing reporting function.  */
void tm_basic_processing_thread_report(void)
{

	unsigned long last_counter;
	unsigned long relative_time;

	/* Initialize the last counter.  */
	last_counter = 0;

	/* Initialize the relative time.  */
	relative_time = 0;

	while (1) {

		/* Sleep to allow the test to run.  */
		tm_thread_sleep(TM_TEST_DURATION);

		/* Increment the relative time.  */
		relative_time = relative_time + TM_TEST_DURATION;

		/* Print results to the stdio window.  */
		printf("**** Thread-Metric Basic Single Thread Processing Test **** Relative Time: "
		       "%lu\n",
		       relative_time);

printf("%lu %lu\n", tm_basic_processing_counter, last_counter);
		/* See if there are any errors.  */
		if (tm_basic_processing_counter == last_counter) {

			printf("ERROR: Invalid counter value(s). Basic processing thread died!\n");
		}

		/* Show the time period total.  */
		printf("Time Period Total:  %lu\n\n", tm_basic_processing_counter - last_counter);

		/* Save the last counter.  */
		last_counter = tm_basic_processing_counter;
	}
}
```

## src/tm_interrupt_preemption_processing_test.c
```c
/***************************************************************************
 * Copyright (c) 2024 Microsoft Corporation
 *
 * This program and the accompanying materials are made available under the
 * terms of the MIT License which is available at
 * https://opensource.org/licenses/MIT.
 *
 * SPDX-License-Identifier: MIT
 **************************************************************************/

/**************************************************************************/
/**************************************************************************/
/**                                                                       */
/** Thread-Metric Component                                               */
/**                                                                       */
/**   Interrupt Preemption Processing Test                                */
/**                                                                       */
/**************************************************************************/
/**************************************************************************/

/**************************************************************************/
/*                                                                        */
/*  FUNCTION                                               RELEASE        */
/*                                                                        */
/*    tm_interrupt_preemption_processing_test             PORTABLE C      */
/*                                                           6.1.7        */
/*  AUTHOR                                                                */
/*                                                                        */
/*    William E. Lamie, Microsoft Corporation                             */
/*                                                                        */
/*  DESCRIPTION                                                           */
/*                                                                        */
/*    This file defines the preemptive scheduling test.                   */
/*                                                                        */
/*  RELEASE HISTORY                                                       */
/*                                                                        */
/*    DATE              NAME                      DESCRIPTION             */
/*                                                                        */
/*  10-15-2021     William E. Lamie         Initial Version 6.1.7         */
/*                                                                        */
/**************************************************************************/

#include "tm_api.h"

/* Define the counters used in the demo application...  */

unsigned long tm_interrupt_preemption_thread_0_counter;
unsigned long tm_interrupt_preemption_thread_1_counter;
unsigned long tm_interrupt_preemption_handler_counter;

/* Define the test thread prototypes.  */

void tm_interrupt_preemption_thread_0_entry(void *p1, void *p2, void *p3);
void tm_interrupt_preemption_thread_1_entry(void *p1, void *p2, void *p3);

/* Define the interrupt handler.  This must be called from the RTOS.  */

void tm_interrupt_handler(void);

/* Define the initialization prototype.  */

void tm_interrupt_preemption_processing_initialize(void);

/* Define the reporting function */

void tm_interrupt_preemption_thread_report(void);

/* Define main entry point.  */

int main(void)
{

	/* Initialize the test.  */
	tm_initialize(tm_interrupt_preemption_processing_initialize);

	return 0;
}

/* Define the interrupt processing test initialization.  */

void tm_interrupt_preemption_processing_initialize(void)
{

	/* Create interrupt thread at priority 3.  */
	tm_thread_create(0, 3, tm_interrupt_preemption_thread_0_entry);

	/* Create thread that generates the interrupt at priority 10.  */
	tm_thread_create(1, 10, tm_interrupt_preemption_thread_1_entry);

	/* Resume just thread 1.  */
	tm_thread_resume(1);

	tm_interrupt_preemption_thread_report();
}

/*
 * Define the interrupt thread.  This thread is resumed from the
 * interrupt handler.  It runs and suspends.
 */
void tm_interrupt_preemption_thread_0_entry(void *p1, void *p2, void *p3)
{

	(void) p1;
	(void) p2;
	(void) p3;

	while (1) {

		/* Increment this thread's counter.  */
		tm_interrupt_preemption_thread_0_counter++;

		/*
		 * Suspend. This will allow the thread generating the
		 * interrupt to run again.
		 */
		tm_thread_suspend(0);
	}
}

/* Define the thread that generates the interrupt.  */
void tm_interrupt_preemption_thread_1_entry(void *p1, void *p2, void *p3)
{

	(void) p1;
	(void) p2;
	(void) p3;

	while (1) {

		/*
		 * Force an interrupt. The underlying RTOS must see that the
		 * the interrupt handler is called from the appropriate software
		 * interrupt or trap.
		 */
		TM_CAUSE_INTERRUPT;

		/*
		 * We won't get back here until the interrupt processing is complete,
		 * including the execution of the higher priority thread made ready
		 * by the interrupt.
		 */

		/* Increment this thread's counter.  */
		tm_interrupt_preemption_thread_1_counter++;
	}
}

/*
 * Define the interrupt handler.  This must be called from the RTOS trap handler.
 * To be fair, it must behave just like a processor interrupt, i.e. it must save
 * the full context of the interrupted thread during the preemption processing.
 */
void tm_interrupt_handler(void)
{

	/* Increment the interrupt count.  */
	tm_interrupt_preemption_handler_counter++;

	/* Resume the higher priority thread from the ISR.  */
	tm_thread_resume(0);
}

/* Define the interrupt test reporting function.  */
void tm_interrupt_preemption_thread_report(void)
{

	unsigned long total;
	unsigned long relative_time;
	unsigned long last_total;
	unsigned long average;

	/* Initialize the last total.  */
	last_total = 0;

	/* Initialize the relative time.  */
	relative_time = 0;

	while (1) {

		/* Sleep to allow the test to run.  */
		tm_thread_sleep(TM_TEST_DURATION);

		/* Increment the relative time.  */
		relative_time = relative_time + TM_TEST_DURATION;

		/* Print results to the stdio window.  */
		printf("**** Thread-Metric Interrupt Preemption Processing Test **** Relative "
		       "Time: %lu\n",
		       relative_time);

		/* Calculate the total of all the counters.  */
		total = tm_interrupt_preemption_thread_0_counter +
			tm_interrupt_preemption_thread_1_counter +
			tm_interrupt_preemption_handler_counter;

		/* Calculate the average of all the counters.  */
		average = total / 3;

		/* See if there are any errors.  */
		if ((tm_interrupt_preemption_thread_0_counter < (average - 1)) ||
		    (tm_interrupt_preemption_thread_0_counter > (average + 1)) ||
		    (tm_interrupt_preemption_thread_1_counter < (average - 1)) ||
		    (tm_interrupt_preemption_thread_1_counter > (average + 1)) ||
		    (tm_interrupt_preemption_handler_counter < (average - 1)) ||
		    (tm_interrupt_preemption_handler_counter > (average + 1))) {

			printf("ERROR: Invalid counter value(s). Interrupt processing test has "
			       "failed!\n");
		}

		/* Show the total interrupts for the time period.  */
		printf("Time Period Total:  %lu\n\n",
		       tm_interrupt_preemption_handler_counter - last_total);

		/* Save the last total number of interrupts.  */
		last_total = tm_interrupt_preemption_handler_counter;
	}
}
```
