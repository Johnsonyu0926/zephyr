## boards/arm/mps3/Kconfig.mps3
```kconfig
# Copyright (c) 2023 Nordic Semiconductor
# Copyright 2024 Arm Limited and/or its affiliates <open-source-office@arm.com>
#
# SPDX-License-Identifier: Apache-2.0

config BOARD_MPS3
	select SOC_SERIES_MPS3
	select SOC_MPS3_CORSTONE300
```

## boards/m5stack/m5stack_cores3/m5stack_cores3_procpu_defconfig
```kconfig
# SPDX-License-Identifier: Apache-2.0


CONFIG_MAIN_STACK_SIZE=2048
CONFIG_CONSOLE=y
CONFIG_SERIAL=y
CONFIG_UART_CONSOLE=y
CONFIG_I2C=y
CONFIG_GPIO=y
#CONFIG_GPIO_AW9523B=y
CONFIG_REGULATOR=y
#CONFIG_REGULATOR_AXP2101=y

CONFIG_SHELL=y
CONFIG_GPIO_SHELL=y
CONFIG_REGULATOR_SHELL=y

CONFIG_LOG=y
CONFIG_LOG_CMDS=y
CONFIG_LOG_BACKEND_UART=y
CONFIG_GPIO_LOG_LEVEL_DBG=y
```

## boards/st/nucleo_g431kb/nucleo_g431kb_defconfig
```kconfig
# SPDX-License-Identifier: Apache-2.0

# Serial drivers
CONFIG_SERIAL=y
CONFIG_UART_INTERRUPT_DRIVEN=y

# Console
CONFIG_CONSOLE=y
CONFIG_UART_CONSOLE=y

# Enable GPIO
CONFIG_GPIO=y

# Enable clocks
CONFIG_CLOCK_CONTROL=y

# Enable MPU
CONFIG_ARM_MPU=y

# Enable HW stack protection
CONFIG_HW_STACK_PROTECTION=y
```

## boards/waveshare/rp2040_zero/Kconfig.defconfig
```kconfig
# Copyright (c) 2021 Yonatan Schachter
# SPDX-License-Identifier: Apache-2.0



if BOARD_RP2040_ZERO

config RP2_FLASH_W25Q080
	default y


if I2C_DW

config I2C_DW_CLOCK_SPEED
	default 125

endif #I2C_DW

config USB_SELF_POWERED
	default n

config CONFIG_SERIAL
	default y

config CONFIG_GPIO
	default y

config CONFIG_CONSOLE
	default y

config CONFIG_UART_CONSOLE
	default y	

endif # BOARD_RP2040_ZERO
```

## drivers/clock_mgmt/Kconfig
```kconfig
# Copyright 2024 NXP
# SPDX-License-Identifier: Apache-2.0

#
# Clock controller drivers
#
menuconfig CLOCK_MGMT
	bool "Clock management drivers"
	help
	  Enable support for clock management drivers. These drivers provide
	  clock configuration to the system via a series of setpoints, which
	  allow drivers to configure clocks based on their desired power
	  state

if CLOCK_MGMT

module = CLOCK_MGMT
module-str = clock management
source "subsys/logging/Kconfig.template.log_config"

config CLOCK_MGMT_SET_RATE
	bool "Support runtime rate setting"
	select CLOCK_MGMT_RUNTIME
	help
	  Allow clock consumers to request a given clock frequency via the
	  clock management framework. The framework will then configure the
	  clock tree so that the consumer is supplied with the closest
	  possible frequency to its request. Note that enabling this feature
	  will result in increased flash utilization

config CLOCK_MGMT_RUNTIME
	bool "Support runtime clock rate requests"
	help
	  Support runtime clock rate requests. When enabled, clock producers
	  will track the clock requests from each consumer, and reject
	  conflicting requests. This Kconfig also enables registering
	  for clock rate change notifications

config CLOCK_MGMT_CLK_NAME
	bool "Store names of each clock"
	help
	  Store names of each clock node. Uses additional ROM space. If
	  clock framework debug logging is enabled, traces will be printed
	  as the clock tree is reconfigured.

config CLOCK_MGMT_FIXED_SOURCE
	bool "Fixed clock source driver"
	default y
	depends on DT_HAS_FIXED_CLOCK_ENABLED
	help
	  Fixed clock source driver, for non configurable clock sources

config CLOCK_MGMT_SOURCE
	bool "Clock source driver"
	default y
	depends on DT_HAS_CLOCK_SOURCE_ENABLED
	help
	  Clock source driver, for fixed clock sources that may be gated/ungated

source "drivers/clock_mgmt/nxp_syscon/Kconfig"

module = CLOCK_MGMT
module-str = clock-mgmt
source "subsys/logging/Kconfig.template.log_config"

endif # CLOCK_MGMT
```

## drivers/hdlc_rcp_if/Kconfig
```kconfig
# Configuration options for HDLC RCP communication Interface

# Copyright (c) 2024 NXP
# SPDX-License-Identifier: Apache-2.0

#
# HDLC communication Interface used by Zephyr running Openthread RCP host
#

menuconfig HDLC_RCP_IF
	bool "HDLC interface for a Zephyr Openthread RCP host"
	depends on NET_L2_OPENTHREAD && !OPENTHREAD_COPROCESSOR

if HDLC_RCP_IF

source "drivers/hdlc_rcp_if/Kconfig.nxp"

module = HDLC_RCP_IF_DRIVER
module-str = HDLC driver for Openthread RCP host
module-help = Sets log level for Openthread HDLC RCP interface Device Drivers.
source "subsys/logging/Kconfig.template.log_config"

endif # HDLC_RCP_IF
```

## drivers/regulator/Kconfig.axp2101
```kconfig
# Copyright (c) 2024 Deng Baoan <dengbaoan@foxmail.com>
# SPDX-License-Identifier: Apache-2.0

config REGULATOR_AXP2101
    bool "AXP2101 PMIC regulator driver"
    default y
    select I2C
    help
      Enable the AXP2101 PMIC regulator driver

if REGULATOR_AXP2101

config REGULATOR_AXP2101_INIT_PRIORITY
    int "AXP2101 regulator init priority"
    default 75
    help
      AXP2101 regulator initialization priority.

endif # REGULATOR_AXP2101
```

## dts/bindings/mtd/nxp,s32-qspi-device.yaml
```yaml
# Copyright 2023-2024 NXP
# SPDX-License-Identifier: Apache-2.0

description: |
  QSPI memory device supporting xSPI or Hyperbus.

compatible: "nxp,s32-qspi-device"

include: [base.yaml, "jedec,jesd216.yaml"]

on-bus: qspi

properties:
  reg:
    required: true

  memory-alignment:
    type: int
    description: |
      Memory alignment in bytes, used to calculate padding when performing
      unaligned accesses.
      If not provided, 1 byte alignment will be selected.

  program-page-size:
    type: int
    required: true
    description: |
      The programming page size of the flash memory device,
      as specified in the flash memory device datasheet.
```

## dts/bindings/qspi/nxp,s32-qspi-sfp-frad.yaml
```yaml
# Copyright 2024 NXP
# SPDX-License-Identifier: Apache-2.0

description: NXP S32 Quad Serial Peripheral Interface (QSPI) Secure Flash Protection SFP FRAD.

  The SFP FRAD performs second-level checks on input flash write and erase transactions,
  based on the address range of each transaction.

compatible: "nxp,s32-qspi-sfp-frad"

include: base.yaml

properties:
  start-address:
    type: int
    required: true
    description: |
      Specifies the specific flash memory region start address.

  end-address:
    type: int
    required: true
    description: |
      Specifies the specific flash memory region end address.

  master-domain-acp-policy:
    type: int
    required: true
    description: |
      Selects the master domain access control policy
      - NON_SECURE: Selects access control policy non-secure
      - SECURE: Selects access control policy secure
      - PRIVILEGE: Selects access control policy privilege

  exclusive-access-lock:
    type: string
    enum:
      - DISABLED
      - OWNER
      - NONE
    default: DISABLED
    description: |
      Selects the exclusive access lock:
      - DISABLED: The exclusive access lock disabled, granting write permissions for all masters
      - ENABLED: The exclusive access lock enabled, granting write permissions only to the
        exclusive access owner master and disabling write permissions for other masters.
      - NONE: This configuration should not be used
      The default corresponds to the reset value of the register field.

  exclusive-access-owner:
    type: int
    default: 0
    description: |
      The domain master ID that owns the exclusive access lock.
      Valid range: 0 - 63. The default corresponds to the reset
      value of the register field.
```

## dts/bindings/usb/raspberrypi,pico-usbd.yaml
```yaml
# Copyright (c) 2021, Pete Johanson
# SPDX-License-Identifier: Apache-2.0

description: |
  RaspberryPi Pico USB Device Controller.

  When the rp2040 is operated as a self powered device,
  VBUS detection needs to be enabled to ensure the correct
  pull up handling on the data lines.
  Example of enabling the controller with vbus detection:

    &pinctrl {
      usb_default: usb_default {
          group1 {
              pinmux = <USB_VBUS_DET_P1>;
              input-enable;
          };
      };
    };

    zephyr_udc0: &usbd {
      status = "okay";
      pinctrl-0 = <&usb_default>;
      pinctrl-names = "default";
    };

compatible: "raspberrypi,pico-usbd"

include: [usb-ep.yaml, reset-device.yaml, pinctrl-device.yaml]

properties:
  reg:
    required: true

  interrupts:
    required: true
```

## soc/ti/simplelink/cc23x0/Kconfig
```kconfig
# Copyright (c) 2024 Texas Instruments Incorporated
# Copyright (c) 2024 BayLibre, SAS
#
# SPDX-License-Identifier: Apache-2.0

config SOC_SERIES_CC23X0
	select ARM
	select CPU_CORTEX_M0PLUS
	select CPU_CORTEX_M_HAS_VTOR
	select TICKLESS_KERNEL
	select DYNAMIC_INTERRUPTS
	select HAS_CC23X0_SDK
	select HAS_TI_CCFG
	select DYNAMIC_DPL_OBJECTS
	select EVENTS
	select DYNAMIC_THREAD
	select DYNAMIC_THREAD_ALLOC
	select THREAD_STACK_INFO

menu "Bootloader Configuration"
depends on SOC_SERIES_CC23X0

choice CC23X0_BLDR_VTOR_TYPE
	prompt "Pointer to user bootloader vector table"
	default CC23X0_BLDR_VTOR_TYPE_UNDEF

config CC23X0_BLDR_VTOR_TYPE_UNDEF
	bool "ROM serial bootloader"

config CC23X0_BLDR_VTOR_TYPE_FORBID
	bool "No bootloader invoked"

config CC23X0_BLDR_VTOR_TYPE_USE_FCFG
	bool "Use factory configuration"

config CC23X0_BLDR_VTOR_TYPE_FLASH
	bool "Use valid main flash address"

endchoice # CC23X0_BLDR_VTOR_TYPE

config CC23X0_BLDR_VTOR_FLASH
	hex "User bootloader vector table address" if CC23X0_BLDR_VTOR_TYPE_FLASH
	range 0 0x0effffff
	default 0
	help
	  Whether a bootloader is run or not and where bootloader parameters are picked from
	  depends on this address. If a bootloader is selected then that bootloader is always
	  invoked as part of the boot process.

config CC23X0_BLDR_ENABLED
	bool "Bootloader commands"
	default n
	help
	  If n, bootloader ignores all commands.

config CC23X0_SERIAL_IO_CFG_INDEX
	int "Serial IO configuration index"
	range 0 2
	default 0
	help
	  Index of which I/O mapping to use for UART/SPI.

config CC23X0_PIN_TRIGGER_ENABLED
	bool "Pin trigger"
	default n
	help
	  If n, bootloader unconditionally triggers. Else normal pin trigger check is performed.

config CC23X0_PIN_TRIGGER_DIO
	int "Trigger DIO pin" if CC23X0_PIN_TRIGGER_ENABLED
	range 0 25
	default 0
	help
	  Index of DIO pin to use for pin trigger check.

config CC23X0_PIN_TRIGGER_LEVEL_HI
	bool "Trigger level high" if CC23X0_PIN_TRIGGER_ENABLED
	default n
	help
	  Level on trigger pin that triggers bootloader.
	  n = Low, y = High.

config CC23X0_P_APP_VTOR
	hex "Application vector table address"
	range 0 0x0effffff
	default 0
	help
	  User application start address.

endmenu # "Bootloader Configuration"
```

## tests/benchmarks/thread_metric/testcase.yaml
```yaml
common:
  tags:
    - kernel
    - benchmark
  integration_platforms:
    - qemu_x86
    - qemu_cortex_a53
  harness: console
  harness_config:
    type: one_line
    regex:
      - "(.*) Relative Time: (.*)"

tests:
  benchmark.thread_metric.basic:
    extra_configs:
      - CONFIG_TM_BASIC=y

  benchmark.thread_metric.cooperative:
    extra_configs:
      - CONFIG_TM_COOPERATIVE=y

  benchmark.thread_metric.interrupt:
    extra_configs:
      - CONFIG_TM_INTERRUPT=y

  benchmark.thread_metric.interrupt_preemption:
    extra_configs:
      - CONFIG_TM_INTERRUPT_PREEMPTION=y

  benchmark.thread_metric.memory_allocation:
    extra_configs:
      - CONFIG_TM_MEMORY_ALLOCATION=y

  benchmark.thread_metric.message:
    extra_configs:
      - CONFIG_TM_MESSAGE=y

  benchmark.thread_metric.preemptive:
    extra_configs:
      - CONFIG_TM_PREEMPTIVE=y

  benchmark.thread_metric.synchronization:
    extra_configs:
      - CONFIG_TM_SYNCHRONIZATION=y
```
